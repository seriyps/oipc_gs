/dts-v1/;
/ {
    metadata {
        title = "INA226 power sensor";
        compatible = "radxa,zero3";
        category = "misc";
        description = "INA226 power sensor. Assumes I2C bus i2c3 (pins 3 and 5), address 0x44 and 0.1 ohm shunt resistor.";
    };
    fragment@0 {
        target-path = "/i2c@fe5c0000"; // Target the I2C bus of i2c3
        __overlay__ {
            ina226@44 {
                compatible = "ti,ina226";
                reg = <0x44>; // I2C address of the INA226 from i2cdetect
                shunt-resistor = <100000>; // Shunt resistor value in micro-ohms (0.1 ohm)
            };
        };
    };
};
